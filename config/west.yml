## config/west.yml
```yaml
manifest:
  remotes:
    - name: zmkfirmware
      url-base: https://github.com/tkhunlertkit/
  projects:
    - name: zmk
      remote: zmkfirmware
      revision: v0.3.tk-r4
      import: app/west.yml
  self:
    path: config
```
